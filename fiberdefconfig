## fiberdefconfig
```kconfig
BR2_aarch64=y
BR2_cortex_a72=y
BR2_ARM_FPU_VFPV4=y
BR2_PACKAGE_HOST_LINUX_HEADERS_CUSTOM_6_1=y
BR2_TOOLCHAIN_BUILDROOT_CXX=y
BR2_TARGET_GENERIC_HOSTNAME="fiber"
BR2_INIT_SYSTEMD=y
BR2_TARGET_GENERIC_ROOT_PASSWD="fiber"
BR2_SYSTEM_DHCP="eth0"
BR2_SYSTEM_DEFAULT_PATH="/bin:/sbin:/usr/bin:/usr/sbin"
BR2_TARGET_LOCALTIME="Europe/Prague"
BR2_ROOTFS_POST_BUILD_SCRIPT="board/raspberrypicm4io-64/post-build.sh"
BR2_ROOTFS_POST_IMAGE_SCRIPT="board/raspberrypicm4io-64/post-image.sh"
BR2_LINUX_KERNEL=y
BR2_LINUX_KERNEL_CUSTOM_TARBALL=y
BR2_LINUX_KERNEL_CUSTOM_TARBALL_LOCATION="$(call github,raspberrypi,linux,17f135b742c4edb340afb365873c3a574f7e16cb)/linux-17f135b742c4edb340afb365873c3a574f7e16cb.tar.gz"
BR2_LINUX_KERNEL_DEFCONFIG="bcm2711"
BR2_LINUX_KERNEL_DTS_SUPPORT=y
BR2_LINUX_KERNEL_INTREE_DTS_NAME="broadcom/bcm2711-rpi-cm4"
BR2_LINUX_KERNEL_NEEDS_HOST_OPENSSL=y
BR2_PACKAGE_LINUX_TOOLS_GPIO=y
BR2_PACKAGE_XZ=y
BR2_PACKAGE_RPI_FIRMWARE=y
BR2_PACKAGE_RPI_FIRMWARE_VARIANT_PI4=y
BR2_PACKAGE_RPI_FIRMWARE_CONFIG_FILE="board/raspberrypicm4io-64/config_cm4io_64bit.txt"
BR2_PACKAGE_HWDATA=y
BR2_PACKAGE_I2C_TOOLS=y
BR2_PACKAGE_PCIUTILS=y
BR2_PACKAGE_PICOCOM=y
BR2_PACKAGE_SPI_TOOLS=y
BR2_PACKAGE_USB_MODESWITCH_DATA=y
BR2_PACKAGE_USBMOUNT=y
BR2_PACKAGE_USBUTILS=y
BR2_PACKAGE_PYTHON3=y
BR2_PACKAGE_PYTHON3_SQLITE=y
BR2_PACKAGE_PYTHON_CLICK=y
BR2_PACKAGE_PYTHON_GPIOD=y
BR2_PACKAGE_PYTHON_LOGURU=y
BR2_PACKAGE_PYTHON_NETIFACES=y
BR2_PACKAGE_PYTHON_PAHO_MQTT=y
BR2_PACKAGE_PYTHON_PILLOW=y
BR2_PACKAGE_PYTHON_PIP=y
BR2_PACKAGE_PYTHON_PYDANTIC=y
BR2_PACKAGE_PYTHON_PYYAML=y
BR2_PACKAGE_PYTHON_SCHEDULE=y
BR2_PACKAGE_PYTHON_SERIAL=y
BR2_PACKAGE_PYTHON_SPIDEV=y
BR2_PACKAGE_LIBCONFIG=y
BR2_PACKAGE_FREETYPE=y
BR2_PACKAGE_LIBGPIOD_TOOLS=y
BR2_PACKAGE_TERMCOLOR=y
BR2_PACKAGE_DROPBEAR=y
BR2_PACKAGE_MODEM_MANAGER_LIBQMI=y
BR2_PACKAGE_MOSQUITTO=y
BR2_PACKAGE_NETWORK_MANAGER=y
BR2_PACKAGE_NETWORK_MANAGER_CLI=y
BR2_PACKAGE_NETWORK_MANAGER_MODEM_MANAGER=y
BR2_PACKAGE_RSYNC=y
BR2_PACKAGE_OPKG=y
BR2_PACKAGE_BASH=y
BR2_PACKAGE_SWUPDATE=y
BR2_PACKAGE_NANO=y
BR2_PACKAGE_FIBER_MODULE_LOAD=y
BR2_PACKAGE_WRITE_RAM_LOGS=y
BR2_PACKAGE_RAM_LOGS=y
BR2_PACKAGE_BLACKLIST_CDC_WDM=y
BR2_TARGET_ROOTFS_EXT2=y
BR2_TARGET_ROOTFS_EXT2_4=y
BR2_TARGET_ROOTFS_EXT2_SIZE="256M"
# BR2_TARGET_ROOTFS_TAR is not set
BR2_PACKAGE_HOST_DOSFSTOOLS=y
BR2_PACKAGE_HOST_GENIMAGE=y
BR2_PACKAGE_HOST_KMOD_XZ=y
BR2_PACKAGE_HOST_MTOOLS=y
BR2_PACKAGE_HOST_RASPBERRYPI_USBBOOT=y
BR2_PACKAGE_HOST_SWUGENERATOR=y
```

## package/blacklist-cdc-wdm/Config.in
```kconfig
# Config.in
config BR2_PACKAGE_BLACKLIST_CDC_WDM
    bool "blacklist-cdc-wdm"
    help
      This package blacklists the cdc-wdm driver to make the qmi driver load faster
```

## package/fiber-module-load/Config.in
```kconfig
config BR2_PACKAGE_FIBER_MODULE_LOAD
    bool "fiber-module-load"
    depends on BR2_PACKAGE_SYSTEMD
    help
      Load the modules required by Fiber
```

## package/python-loguru/Config.in
```kconfig
config BR2_PACKAGE_PYTHON_LOGURU
	bool "python-loguru"
	help
	  Loguru is a library which aims to bring enjoyable logging in Python.

	  https://github.com/Delgan/loguru
```

## package/python-smbus2/Config.in
```kconfig
config BR2_PACKAGE_PYTHON_SMBUS2
	bool "python-smbus2"
	help
	  A simple wrapper around optparse for powerful command line
	  utilities.

	  https://pypi.org/project/smbus2
```

## package/ram-logs/Config.in
```kconfig
# Config.in
config BR2_PACKAGE_RAM_LOGS
    bool "ram-logs"
    help
      This package adds a tmpfs mount for /var/log to the system's fstab file.
```

## package/write-ram-logs/Config.in
```kconfig
config BR2_PACKAGE_WRITE_RAM_LOGS
    bool "write-ram-logs"
    help
      This option enables the write_tmpfs_to_disk service, which
      periodically writes the contents of a tmpfs filesystem to disk.
      This can be useful for systems that store logs or other data in
      a tmpfs to reduce disk I/O, but still want to periodically save
      this data to disk to prevent it from being lost on reboot.
```
